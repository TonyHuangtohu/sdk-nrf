## samples/dfu/ab/sample.yaml
```yaml
sample:
  description: AB update sample
  name: ab
common:
  sysbuild: true
  build_only: true
  tags:
    - dfu_ab
    - ci_samples_dfu

tests:
  sample.dfu.ab:
    platform_allow:
      - nrf54h20dk/nrf54h20/cpuapp
      - nrf54l15dk/nrf54l10/cpuapp
      - nrf54l15dk/nrf54l15/cpuapp
      - nrf54lm20dk/nrf54lm20a/cpuapp
    integration_platforms:
      - nrf54h20dk/nrf54h20/cpuapp
      - nrf54l15dk/nrf54l10/cpuapp
      - nrf54l15dk/nrf54l15/cpuapp
      - nrf54lm20dk/nrf54lm20a/cpuapp

  sample.dfu.ab.load_periphconf:
    platform_allow:
      - nrf54h20dk/nrf54h20/cpuapp
    integration_platforms:
      - nrf54h20dk/nrf54h20/cpuapp
    extra_args:
      - SB_CONFIG_NCS_MCUBOOT_LOAD_PERIPHCONF=y
```
