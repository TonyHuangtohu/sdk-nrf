## prj.conf
```kconfig
#
# Copyright (c) 2024 Nordic Semiconductor ASA
#
# SPDX-License-Identifier: LicenseRef-Nordic-5-Clause
#

# Enable CHIP
CONFIG_CHIP=y
CONFIG_CHIP_PROJECT_CONFIG="src/chip_project_config.h"
CONFIG_CHIP_DEVICE_PRODUCT_NAME="Matter Smoke CO Alarm"

# Configure ZAP file name
CONFIG_NCS_SAMPLE_MATTER_ZAP_FILE_PATH="${APPLICATION_CONFIG_DIR}/src/default_zap/smoke_co_alarm.zap"

# 32768 == 0x8000 (example Product ID added temporaly,
# as there is no assigned PID on the following list:
# https://github.com/project-chip/connectedhomeip/blob/482e6fd03196a6de45465a90003947ef4b86e0b1/docs/examples/discussion/PID_allocation_for_example_apps.md)
CONFIG_CHIP_DEVICE_PRODUCT_ID=32768
CONFIG_STD_CPP17=y

# Enable Matter pairing automatically on application start.
CONFIG_CHIP_ENABLE_PAIRING_AUTOSTART=y

# Enable Matter extended announcement and increase duration to 1 hour.
CONFIG_CHIP_BLE_EXT_ADVERTISING=y
CONFIG_CHIP_BLE_ADVERTISING_DURATION=60

# Add support for LEDs and buttons on Nordic development kits
CONFIG_DK_LIBRARY=y

# Bluetooth Low Energy configuration
CONFIG_BT_DEVICE_NAME="MatterSmoke"

# Suspend devices when the CPU goes into sleep
CONFIG_PM_DEVICE=y

# Other settings
CONFIG_THREAD_NAME=y
CONFIG_MPU_STACK_GUARD=y
CONFIG_RESET_ON_FATAL_ERROR=n
CONFIG_CHIP_LIB_SHELL=y

# Reduce application size
CONFIG_USE_SEGGER_RTT=n

# Enable Factory Data feature
CONFIG_CHIP_FACTORY_DATA=y
CONFIG_CHIP_FACTORY_DATA_BUILD=y

CONFIG_BT_CTLR_PHY_2M=y
```

## src/main.cpp
```c
/*
 * Copyright (c) 2024 Nordic Semiconductor ASA
 *
 * SPDX-License-Identifier: LicenseRef-Nordic-5-Clause
 */

#include "app_task.h"

#include <app_version.h>
#include <zephyr/logging/log.h>

LOG_MODULE_REGISTER(app, CONFIG_CHIP_APP_LOG_LEVEL);

int main()
{
	LOG_INF("APP_VERSION_STRING :%s ...", APP_VERSION_STRING);
	CHIP_ERROR err = AppTask::Instance().StartApp();

	LOG_ERR("Exited with code %" CHIP_ERROR_FORMAT, err.Format());
	return err == CHIP_NO_ERROR ? EXIT_SUCCESS : EXIT_FAILURE;
}
```

## src/app_task.cpp
```c
/*
 * Copyright (c) 2024 Nordic Semiconductor ASA
 *
 * SPDX-License-Identifier: LicenseRef-Nordic-5-Clause
 */

#include "app_task.h"

#include "app/matter_init.h"
#include "app/task_executor.h"
#include "board/board.h"
#include "lib/core/CHIPError.h"
#include "lib/support/CodeUtils.h"
#include "clusters/identify.h"

#include <app-common/zap-generated/attributes/Accessors.h>
#include <app/clusters/smoke-co-alarm-server/SmokeCOTestEventTriggerHandler.h>
#include <app/clusters/smoke-co-alarm-server/smoke-co-alarm-server.h>
#include <setup_payload/OnboardingCodesUtil.h>

#include <zephyr/logging/log.h>
#include <zephyr/sys/reboot.h>
#include <zephyr/storage/flash_map.h>

#define EXT_FLASH_PARTITION     external_flash
#define EXT_FLASH_PARTITION_ID  FIXED_PARTITION_ID(EXT_FLASH_PARTITION)

LOG_MODULE_DECLARE(app, CONFIG_CHIP_APP_LOG_LEVEL);

using namespace ::chip;
using namespace ::chip::app;
using namespace ::chip::DeviceLayer;

namespace
{

constexpr uint32_t kExpressedStateLedEvenBlinkMs = 300;
constexpr uint32_t kExpressedStateLedOddBlink1Ms = 300;
constexpr uint32_t kExpressedStateLedOddBlink2Ms = 700;
constexpr uint32_t kSelfTestDurationMs = 5000;
constexpr uint32_t kSelfTestLedUpdateTimeMs = 200;

static std::array<Clusters::SmokeCoAlarm::ExpressedStateEnum, SmokeCoAlarmServer::kPriorityOrderLength>
	sPriorityOrder = { Clusters::SmokeCoAlarm::ExpressedStateEnum::kSmokeAlarm,
			   Clusters::SmokeCoAlarm::ExpressedStateEnum::kCOAlarm,
			   Clusters::SmokeCoAlarm::ExpressedStateEnum::kHardwareFault,
			   Clusters::SmokeCoAlarm::ExpressedStateEnum::kTesting,
			   Clusters::SmokeCoAlarm::ExpressedStateEnum::kEndOfService,
			   Clusters::SmokeCoAlarm::ExpressedStateEnum::kBatteryAlert,
			   Clusters::SmokeCoAlarm::ExpressedStateEnum::kInterconnectSmoke,
			   Clusters::SmokeCoAlarm::ExpressedStateEnum::kInterconnectCO };

constexpr chip::EndpointId kWiredPowerSourceEndpointId = 0;
constexpr chip::EndpointId kBatteryPowerSourceEndpointId = 1;

Nrf::Matter::IdentifyCluster sIdentifyCluster(AppTask::kSmokeCoAlarmEndpointId);

#ifdef CONFIG_CHIP_ICD_UAT_SUPPORT
#define UAT_BUTTON_MASK DK_BTN3_MSK
#define SWITCHING_BUTTON_MASK DK_BTN3_MSK

k_timer sSwitchTransportTimer;

constexpr uint32_t kSwitchTransportTimeout = 5000;
#endif
} /* namespace */


void AppTask::SwitchTransportEventHandler()
{
	int rc;

	LOG_INF("Starting switching to Zigbee......");

	const struct flash_area *pfa;
	uint8_t write_buf[16] = {0x55, 0x02, 0x03, 0x04,
							 0x05, 0x06, 0x07, 0x08,
							 0x09, 0x0A, 0x0B, 0x0C,
							 0x0D, 0x0E, 0x0F, 0x10};
	uint8_t read_buf[16] = {0};

	rc = flash_area_open(EXT_FLASH_PARTITION_ID, &pfa);
	if (rc < 0)
	{
		printk("FAIL: unable to find flash area %u: %d\n",
			   EXT_FLASH_PARTITION_ID, rc);
		return ;
	}

	rc = flash_area_read(pfa, 0, read_buf, sizeof(read_buf));
	if (rc < 0)
	{
		printk("FAIL: flash read error: %d\n", rc);
		flash_area_close(pfa);
		return ;
	}

	rc = flash_area_erase(pfa, 0, pfa->fa_size);
	if (rc < 0)
	{
		printk("FAIL: flash erase error: %d\n", rc);
		flash_area_close(pfa);
	}

	rc = flash_area_write(pfa, 0, write_buf, sizeof(write_buf));
	if (rc < 0)
	{
		printk("FAIL: flash write error: %d\n", rc);
		flash_area_close(pfa);
	}

	flash_area_close(pfa);

	CHIP_ERROR error = SystemLayer().ScheduleLambda([] {
		PlatformMgr().HandleServerShuttingDown();
		//ConfigurationMgr().InitiateFactoryReset();
	});

	sys_reboot(SYS_REBOOT_COLD);
}

void AppTask::SwitchTransportTimerTimeoutCallback(k_timer *timer)
{
	Nrf::PostTask([] { SwitchTransportEventHandler(); });
}

void AppTask::SwitchTransportTriggerHandler(const SwitchButtonAction &action)
{
	if (action == SwitchButtonAction::Pressed) {
		LOG_INF("k_timer_start.");
		k_timer_start(&sSwitchTransportTimer, K_MSEC(kSwitchTransportTimeout), K_NO_WAIT);
	} else {
		LOG_INF("k_timer_stop.");
		k_timer_stop(&sSwitchTransportTimer);
	}
}

void AppTask::ButtonEventHandler(Nrf::ButtonState state, Nrf::ButtonMask hasChanged)
{
#ifdef CONFIG_CHIP_ICD_UAT_SUPPORT
	if ((UAT_BUTTON_MASK & state & hasChanged)) {
		LOG_INF("ICD UserActiveMode has been triggered.");
		Server::GetInstance().GetICDManager().OnNetworkActivity();
	}
#endif
	if (SWITCHING_BUTTON_MASK & hasChanged) {
		SwitchButtonAction action =
			(SWITCHING_BUTTON_MASK & state) ? SwitchButtonAction::Pressed : SwitchButtonAction::Released;
		Nrf::PostTask([action] { SwitchTransportTriggerHandler(action); });
	}
}

void AppTask::UpdatedExpressedLedState()
{
	Clusters::SmokeCoAlarm::ExpressedStateEnum state;
	SmokeCoAlarmServer::Instance().GetExpressedState(AppTask::kSmokeCoAlarmEndpointId, state);

	if (mCurrentState == state) {
		return;
	}
	mCurrentState = state;

	k_timer_stop(&mSelfTestLedTimer);

	switch (state) {
	case Clusters::SmokeCoAlarm::ExpressedStateEnum::kNormal:
		Nrf::GetBoard().GetLED(Nrf::DeviceLeds::LED2).Set(false);
		Nrf::GetBoard().GetLED(Nrf::DeviceLeds::LED3).Set(false);
		Nrf::GetBoard().GetLED(Nrf::DeviceLeds::LED4).Set(false);
		break;
	case Clusters::SmokeCoAlarm::ExpressedStateEnum::kSmokeAlarm:
		Nrf::GetBoard().GetLED(Nrf::DeviceLeds::LED2).Blink(kExpressedStateLedEvenBlinkMs);
		Nrf::GetBoard().GetLED(Nrf::DeviceLeds::LED3).Set(false);
		Nrf::GetBoard().GetLED(Nrf::DeviceLeds::LED4).Set(false);
		break;
	case Clusters::SmokeCoAlarm::ExpressedStateEnum::kCOAlarm:
		Nrf::GetBoard().GetLED(Nrf::DeviceLeds::LED2).Set(false);
		Nrf::GetBoard().GetLED(Nrf::DeviceLeds::LED3).Blink(kExpressedStateLedEvenBlinkMs);
		Nrf::GetBoard().GetLED(Nrf::DeviceLeds::LED4).Set(false);
		break;
	case Clusters::SmokeCoAlarm::ExpressedStateEnum::kBatteryAlert:
		Nrf::GetBoard().GetLED(Nrf::DeviceLeds::LED2).Set(false);
		Nrf::GetBoard().GetLED(Nrf::DeviceLeds::LED3).Set(false);
		Nrf::GetBoard().GetLED(Nrf::DeviceLeds::LED4).Blink(kExpressedStateLedEvenBlinkMs);
		break;
	case Clusters::SmokeCoAlarm::ExpressedStateEnum::kTesting:
		Nrf::GetBoard().GetLED(Nrf::DeviceLeds::LED2).Set(false);
		Nrf::GetBoard().GetLED(Nrf::DeviceLeds::LED3).Set(false);
		Nrf::GetBoard().GetLED(Nrf::DeviceLeds::LED4).Set(false);

		k_timer_start(&mSelfTestLedTimer, K_MSEC(kSelfTestLedUpdateTimeMs), K_NO_WAIT);
		Nrf::GetBoard().GetLED(Nrf::DeviceLeds::LED2).Set(true);

		break;
	case Clusters::SmokeCoAlarm::ExpressedStateEnum::kHardwareFault:
		Nrf::GetBoard().GetLED(Nrf::DeviceLeds::LED2).Set(false);
		Nrf::GetBoard().GetLED(Nrf::DeviceLeds::LED3).Set(false);
		Nrf::GetBoard().GetLED(Nrf::DeviceLeds::LED4).Set(false);

		Nrf::GetBoard()
			.GetLED(Nrf::DeviceLeds::LED2)
			.Blink(kExpressedStateLedOddBlink1Ms, kExpressedStateLedOddBlink2Ms);
		Nrf::GetBoard()
			.GetLED(Nrf::DeviceLeds::LED3)
			.Blink(kExpressedStateLedOddBlink1Ms, kExpressedStateLedOddBlink2Ms);
		Nrf::GetBoard()
			.GetLED(Nrf::DeviceLeds::LED4)
			.Blink(kExpressedStateLedOddBlink1Ms, kExpressedStateLedOddBlink2Ms);
		break;
	case Clusters::SmokeCoAlarm::ExpressedStateEnum::kEndOfService:
		Nrf::GetBoard().GetLED(Nrf::DeviceLeds::LED2).Set(false);
		Nrf::GetBoard().GetLED(Nrf::DeviceLeds::LED3).Set(false);
		Nrf::GetBoard().GetLED(Nrf::DeviceLeds::LED4).Set(false);

		Nrf::GetBoard()
			.GetLED(Nrf::DeviceLeds::LED2)
			.Blink(kExpressedStateLedOddBlink2Ms, kExpressedStateLedOddBlink1Ms);
		Nrf::GetBoard()
			.GetLED(Nrf::DeviceLeds::LED3)
			.Blink(kExpressedStateLedOddBlink2Ms, kExpressedStateLedOddBlink1Ms);
		Nrf::GetBoard()
			.GetLED(Nrf::DeviceLeds::LED4)
			.Blink(kExpressedStateLedOddBlink2Ms, kExpressedStateLedOddBlink1Ms);
		break;
	case Clusters::SmokeCoAlarm::ExpressedStateEnum::kInterconnectSmoke:
	case Clusters::SmokeCoAlarm::ExpressedStateEnum::kInterconnectCO:
	case Clusters::SmokeCoAlarm::ExpressedStateEnum::kUnknownEnumValue:
	default:
		break;
	}
}

bool HandleSmokeCOTestEventTrigger(uint64_t eventTrigger)
{
	SmokeCOTrigger trigger = static_cast<SmokeCOTrigger>(eventTrigger);

	switch (trigger) {
	case SmokeCOTrigger::kForceSmokeCritical:
		LOG_INF("Triggered smoke alarm with critical severity");
		VerifyOrReturnValue(SmokeCoAlarmServer::Instance().SetSmokeState(
					    AppTask::kSmokeCoAlarmEndpointId, Clusters::SmokeCoAlarm::AlarmStateEnum::kCritical),
				    false);
		SmokeCoAlarmServer::Instance().SetExpressedStateByPriority(AppTask::kSmokeCoAlarmEndpointId, sPriorityOrder);
		break;
	case SmokeCOTrigger::kForceCOCritical:
		LOG_INF("Triggered CO alarm with critical severity");
		VerifyOrReturnValue(SmokeCoAlarmServer::Instance().SetCOState(
					    AppTask::kSmokeCoAlarmEndpointId, Clusters::SmokeCoAlarm::AlarmStateEnum::kCritical),
				    false);
		SmokeCoAlarmServer::Instance().SetExpressedStateByPriority(AppTask::kSmokeCoAlarmEndpointId, sPriorityOrder);
		break;
	case SmokeCOTrigger::kForceMalfunction:
		LOG_INF("Triggered hardware fault alert");
		VerifyOrReturnValue(SmokeCoAlarmServer::Instance().SetHardwareFaultAlert(AppTask::kSmokeCoAlarmEndpointId, true),
				    false);
		SmokeCoAlarmServer::Instance().SetExpressedStateByPriority(AppTask::kSmokeCoAlarmEndpointId, sPriorityOrder);
		break;
	case SmokeCOTrigger::kForceLowBatteryCritical:
		LOG_INF("Triggered low battery alert with critical severity");
		VerifyOrReturnValue(SmokeCoAlarmServer::Instance().SetBatteryAlert(
					    AppTask::kSmokeCoAlarmEndpointId, Clusters::SmokeCoAlarm::AlarmStateEnum::kCritical),
				    false);
		SmokeCoAlarmServer::Instance().SetExpressedStateByPriority(AppTask::kSmokeCoAlarmEndpointId, sPriorityOrder);
		break;
	case SmokeCOTrigger::kForceEndOfLife:
		LOG_INF("Triggered end of service alert");
		VerifyOrReturnValue(SmokeCoAlarmServer::Instance().SetEndOfServiceAlert(
					    AppTask::kSmokeCoAlarmEndpointId,
					    Clusters::SmokeCoAlarm::EndOfServiceEnum::kExpired),
				    false);
		SmokeCoAlarmServer::Instance().SetExpressedStateByPriority(AppTask::kSmokeCoAlarmEndpointId, sPriorityOrder);
		break;
	case SmokeCOTrigger::kClearSmoke:
		LOG_INF("Triggered end of smoke alarm action");
		VerifyOrReturnValue(SmokeCoAlarmServer::Instance().SetSmokeState(
					    AppTask::kSmokeCoAlarmEndpointId, Clusters::SmokeCoAlarm::AlarmStateEnum::kNormal),
				    false);
		SmokeCoAlarmServer::Instance().SetExpressedStateByPriority(AppTask::kSmokeCoAlarmEndpointId, sPriorityOrder);
		break;
	case SmokeCOTrigger::kClearCO:
		LOG_INF("Triggered end of CO alarm action");
		VerifyOrReturnValue(SmokeCoAlarmServer::Instance().SetCOState(
					    AppTask::kSmokeCoAlarmEndpointId, Clusters::SmokeCoAlarm::AlarmStateEnum::kNormal),
				    false);
		SmokeCoAlarmServer::Instance().SetExpressedStateByPriority(AppTask::kSmokeCoAlarmEndpointId, sPriorityOrder);
		break;
	case SmokeCOTrigger::kClearMalfunction:
		LOG_INF("Triggered end of hardware fault alert action");
		VerifyOrReturnValue(
			SmokeCoAlarmServer::Instance().SetHardwareFaultAlert(AppTask::kSmokeCoAlarmEndpointId, false), false);
		SmokeCoAlarmServer::Instance().SetExpressedStateByPriority(AppTask::kSmokeCoAlarmEndpointId, sPriorityOrder);
		break;
	case SmokeCOTrigger::kClearEndOfLife:
		LOG_INF("Triggered end of end of service alert action");
		VerifyOrReturnValue(SmokeCoAlarmServer::Instance().SetEndOfServiceAlert(
					    AppTask::kSmokeCoAlarmEndpointId, Clusters::SmokeCoAlarm::EndOfServiceEnum::kNormal),
				    false);
		SmokeCoAlarmServer::Instance().SetExpressedStateByPriority(AppTask::kSmokeCoAlarmEndpointId, sPriorityOrder);
		break;
	case SmokeCOTrigger::kClearBatteryLevelLow:
		LOG_INF("Triggered end of low battery level alert action");
		VerifyOrReturnValue(SmokeCoAlarmServer::Instance().SetBatteryAlert(
					    AppTask::kSmokeCoAlarmEndpointId, Clusters::SmokeCoAlarm::AlarmStateEnum::kNormal),
				    false);
		SmokeCoAlarmServer::Instance().SetExpressedStateByPriority(AppTask::kSmokeCoAlarmEndpointId, sPriorityOrder);
		break;
	case SmokeCOTrigger::kForceSmokeWarning:
		LOG_WRN("Triggered unsupported smoke alarm with warning severity");
		return false;
	case SmokeCOTrigger::kForceSmokeInterconnect:
		LOG_WRN("Triggered unsupported smoke interconnect alarm");
		return false;
	case SmokeCOTrigger::kForceCOWarning:
		LOG_WRN("Triggered unsupported CO alarm with warning severity");
		return false;
	case SmokeCOTrigger::kForceCOInterconnect:
		LOG_WRN("Triggered unsupported CO interconnect alarm");
		return false;
	case SmokeCOTrigger::kForceSmokeContaminationHigh:
		LOG_WRN("Triggered unsupported high smoke contamination alarm");
		return false;
	case SmokeCOTrigger::kForceSmokeContaminationLow:
		LOG_WRN("Triggered unsupported low smoke contamination alarm");
		return false;
	case SmokeCOTrigger::kForceSmokeSensitivityHigh:
		LOG_WRN("Triggered unsupported high smoke sensitivity alarm");
		return false;
	case SmokeCOTrigger::kForceSmokeSensitivityLow:
		LOG_WRN("Triggered unsupported low smoke sensitivity alarm");
		return false;
	case SmokeCOTrigger::kForceLowBatteryWarning:
		LOG_WRN("Triggered unsupported low battery alert with warning severity");
		return false;
	case SmokeCOTrigger::kForceSilence:
		LOG_WRN("Triggered unsupported alarm mute action");
		return false;
	case SmokeCOTrigger::kClearSmokeInterconnect:
		LOG_WRN("Triggered unsupported end of smoke interconnect alarm action");
		return false;
	case SmokeCOTrigger::kClearCOInterconnect:
		LOG_WRN("Triggered unsupported end of CO interconnect alarm action");
		return false;
	case SmokeCOTrigger::kClearSilence:
		LOG_WRN("Triggered unsupported unmute action");
		return false;
	case SmokeCOTrigger::kClearContamination:
		LOG_WRN("Triggered unsupported end of smoke contamination alert action");
		return false;
	case SmokeCOTrigger::kClearSensitivity:
		LOG_WRN("Triggered unsupported end of smoke sensitivity alert action");
		return false;
	default:
		return false;
	}

	AppTask::Instance().UpdatedExpressedLedState();

	return true;
}

void AppTask::SelfTestTimerTimeoutCallback(k_timer *timer)
{
	Nrf::PostTask([] { EndSelfTestEventHandler(); });
}

void AppTask::EndSelfTestEventHandler()
{
	LOG_INF("Alarm self test action end");
	SmokeCoAlarmServer::Instance().SetTestInProgress(kSmokeCoAlarmEndpointId, false);
	SmokeCoAlarmServer::Instance().SetExpressedStateByPriority(kSmokeCoAlarmEndpointId, sPriorityOrder);
	Instance().UpdatedExpressedLedState();
}

void AppTask::SelfTestLedTimerTimeoutCallback(k_timer *timer)
{
	Nrf::PostTask([] { SelfTestLedTimerEventHandler(); });
}

void AppTask::SelfTestLedTimerEventHandler()
{
	if (Nrf::GetBoard().GetLED(Nrf::DeviceLeds::LED2).GetState()) {
		Nrf::GetBoard().GetLED(Nrf::DeviceLeds::LED2).Set(false);
		Nrf::GetBoard().GetLED(Nrf::DeviceLeds::LED3).Set(true);
	} else if (Nrf::GetBoard().GetLED(Nrf::DeviceLeds::LED3).GetState()) {
		Nrf::GetBoard().GetLED(Nrf::DeviceLeds::LED3).Set(false);
		Nrf::GetBoard().GetLED(Nrf::DeviceLeds::LED4).Set(true);
	} else if (Nrf::GetBoard().GetLED(Nrf::DeviceLeds::LED4).GetState()) {
		Nrf::GetBoard().GetLED(Nrf::DeviceLeds::LED4).Set(false);
		Nrf::GetBoard().GetLED(Nrf::DeviceLeds::LED2).Set(true);
	}

	k_timer_start(&Instance().mSelfTestLedTimer, K_MSEC(kSelfTestLedUpdateTimeMs), K_NO_WAIT);
}

#ifdef CONFIG_NCS_SAMPLE_MATTER_TEST_EVENT_TRIGGERS
CHIP_ERROR AppTask::PowerSourceOnEventCallback(Nrf::Matter::TestEventTrigger::TriggerValue endpointId)
{
	if (endpointId == kWiredPowerSourceEndpointId || endpointId == kBatteryPowerSourceEndpointId) {
		LOG_INF("Event Trigger: Power Source on endpoint id %d activated.", endpointId);
	} else {
		LOG_ERR("Event Trigger: Power Source On triggered on invalid endpoint id %d", endpointId);
		return CHIP_ERROR_INVALID_ARGUMENT;
	}

	/* Wired power source is treated as primary one. */
	if (endpointId == kWiredPowerSourceEndpointId) {
		Clusters::PowerSource::Attributes::Status::Set(kWiredPowerSourceEndpointId,
							       Clusters::PowerSource::PowerSourceStatusEnum::kActive);

		Clusters::PowerSource::PowerSourceStatusEnum status;
		Clusters::PowerSource::Attributes::Status::Get(kBatteryPowerSourceEndpointId, &status);

		/* If battery power source was active, change its state to standby. */
		if (status == Clusters::PowerSource::PowerSourceStatusEnum::kActive) {
			Clusters::PowerSource::Attributes::Status::Set(
				kBatteryPowerSourceEndpointId, Clusters::PowerSource::PowerSourceStatusEnum::kStandby);
		}
	} else {
		Clusters::PowerSource::PowerSourceStatusEnum status;
		Clusters::PowerSource::Attributes::Status::Get(kWiredPowerSourceEndpointId, &status);

		/* If wired power source is active, change put requested power source into standby state to standby. */
		if (status == Clusters::PowerSource::PowerSourceStatusEnum::kActive) {
			Clusters::PowerSource::Attributes::Status::Set(
				kBatteryPowerSourceEndpointId, Clusters::PowerSource::PowerSourceStatusEnum::kStandby);
		} else {
			Clusters::PowerSource::Attributes::Status::Set(
				kBatteryPowerSourceEndpointId, Clusters::PowerSource::PowerSourceStatusEnum::kActive);
		}
	}

	return CHIP_NO_ERROR;
}

CHIP_ERROR AppTask::PowerSourceOffEventCallback(Nrf::Matter::TestEventTrigger::TriggerValue endpointId)
{
	if (endpointId == kWiredPowerSourceEndpointId || endpointId == kBatteryPowerSourceEndpointId) {
		LOG_INF("Event Trigger: Power Source on endpoint id %d deactivated.", endpointId);
	} else {
		LOG_ERR("Event Trigger: Power Source Off triggered on invalid endpoint id %d", endpointId);
		return CHIP_ERROR_INVALID_ARGUMENT;
	}

	/* Wired power source is treated as primary one. */
	if (endpointId == kWiredPowerSourceEndpointId) {
		Clusters::PowerSource::Attributes::Status::Set(
			kWiredPowerSourceEndpointId, Clusters::PowerSource::PowerSourceStatusEnum::kUnavailable);

		Clusters::PowerSource::PowerSourceStatusEnum status;
		Clusters::PowerSource::Attributes::Status::Get(kBatteryPowerSourceEndpointId, &status);

		/* If battery power source was standby, change its state to active. */
		if (status == Clusters::PowerSource::PowerSourceStatusEnum::kStandby) {
			Clusters::PowerSource::Attributes::Status::Set(
				kBatteryPowerSourceEndpointId, Clusters::PowerSource::PowerSourceStatusEnum::kActive);
		}
	} else {
		Clusters::PowerSource::Attributes::Status::Set(
			kBatteryPowerSourceEndpointId, Clusters::PowerSource::PowerSourceStatusEnum::kUnavailable);
	}

	return CHIP_NO_ERROR;
}
#endif

CHIP_ERROR AppTask::Init()
{
	/* Initialize Matter stack */
	ReturnErrorOnFailure(Nrf::Matter::PrepareServer());

	if (!Nrf::GetBoard().Init(ButtonEventHandler)) {
		LOG_ERR("User interface initialization failed.");
		return CHIP_ERROR_INCORRECT_STATE;
	}

	k_timer_init(&mSelfTestLedTimer, &SelfTestLedTimerTimeoutCallback, nullptr);
	k_timer_init(&mSelfTestTimer, &SelfTestTimerTimeoutCallback, nullptr);
	k_timer_init(&sSwitchTransportTimer, &AppTask::SwitchTransportTimerTimeoutCallback, nullptr);

	/* Register Matter event handler that controls the connectivity status LED based on the captured Matter network
	 * state. */
	ReturnErrorOnFailure(Nrf::Matter::RegisterEventHandler(Nrf::Board::DefaultMatterEventHandler, 0));

	/* Register Smoke CO Alarm test event triggers */
#ifdef CONFIG_NCS_SAMPLE_MATTER_TEST_EVENT_TRIGGERS
	/* Register Smoke CO alarm test events handler */
	static chip::SmokeCOTestEventTriggerHandler sSmokeCoAlarmTestEventTrigger;
	ReturnErrorOnFailure(Nrf::Matter::TestEventTrigger::Instance().RegisterTestEventTriggerHandler(
		&sSmokeCoAlarmTestEventTrigger));

	/* Register test event handler to change the power source. */
	ReturnErrorOnFailure(Nrf::Matter::TestEventTrigger::Instance().RegisterTestEventTrigger(
		kPowerSourceOnEventTriggerId,
		Nrf::Matter::TestEventTrigger::EventTrigger{ 0xFFFF, PowerSourceOnEventCallback }));
	ReturnErrorOnFailure(Nrf::Matter::TestEventTrigger::Instance().RegisterTestEventTrigger(
		kPowerSourceOffEventTriggerId,
		Nrf::Matter::TestEventTrigger::EventTrigger{ 0xFFFF, PowerSourceOffEventCallback }));
#endif

	ReturnErrorOnFailure(sIdentifyCluster.Init());

	return Nrf::Matter::StartServer();
}

CHIP_ERROR AppTask::StartApp()
{
	ReturnErrorOnFailure(Init());

	while (true) {
		Nrf::DispatchNextTask();
	}

	return CHIP_NO_ERROR;
}

void AppTask::SelfTestHandler()
{
	LOG_INF("Triggered alarm self test action");
	k_timer_start(&Instance().mSelfTestTimer, K_MSEC(kSelfTestDurationMs), K_NO_WAIT);
	UpdatedExpressedLedState();
}
```

## src/app_task.h
```c
/*
 * Copyright (c) 2024 Nordic Semiconductor ASA
 *
 * SPDX-License-Identifier: LicenseRef-Nordic-5-Clause
 */

#pragma once

#include "board/board.h"

#include <platform/CHIPDeviceLayer.h>

#ifdef CONFIG_NCS_SAMPLE_MATTER_TEST_EVENT_TRIGGERS
#include "event_triggers/event_triggers.h"
#endif

struct k_timer;
struct Identify;

enum class SwitchButtonAction : uint8_t { Pressed, Released };

class AppTask {
public:
	static AppTask &Instance()
	{
		static AppTask sAppTask;
		return sAppTask;
	};

	static constexpr chip::EndpointId kSmokeCoAlarmEndpointId = 1;

	CHIP_ERROR StartApp();

	void UpdatedExpressedLedState();
	void SelfTestHandler();

private:
	CHIP_ERROR Init();

	static void ButtonEventHandler(Nrf::ButtonState state, Nrf::ButtonMask hasChanged);
	static void SelfTestLedTimerTimeoutCallback(k_timer *timer);
	static void SelfTestLedTimerEventHandler();
	static void SelfTestTimerTimeoutCallback(k_timer *timer);
	static void EndSelfTestEventHandler();

	static void SwitchTransportEventHandler();
	static void SwitchTransportTimerTimeoutCallback(k_timer *timer);
	static void SwitchTransportTriggerHandler(const SwitchButtonAction &action);

#ifdef CONFIG_NCS_SAMPLE_MATTER_TEST_EVENT_TRIGGERS
	constexpr static Nrf::Matter::TestEventTrigger::EventTriggerId kPowerSourceOnEventTriggerId =
		0xFFFF'FFFF'8000'0000;
	constexpr static Nrf::Matter::TestEventTrigger::EventTriggerId kPowerSourceOffEventTriggerId =
		0xFFFF'FFFF'8001'0000;
	static CHIP_ERROR PowerSourceOnEventCallback(Nrf::Matter::TestEventTrigger::TriggerValue);
	static CHIP_ERROR PowerSourceOffEventCallback(Nrf::Matter::TestEventTrigger::TriggerValue);
#endif

	k_timer mSelfTestLedTimer;
	k_timer mSelfTestTimer;
	chip::app::Clusters::SmokeCoAlarm::ExpressedStateEnum mCurrentState;
};
```
